VERSION "0.10"

NS_ :

BS_:
BU_: MASTER SLAVE

BO_ 2554252520 TEMP_VOLTAGE_FRAME: 8 MASTER
    SG_ temperature_diode : 0|8@1+ (1,-40) [-40|215] "Celcius" SLAVE
    SG_ voltage_max_mono : 40|16@0+ (0.001,0) [0|65.535] "Volts" SLAVE
    SG_ voltage_min_mono : 24|16@0+ (0.001,0) [0|65.535] "Volts" SLAVE
    SG_ temperature_contactor : 40|8@1+ (1,-40) [-40|215] "Celcius" SLAVE
    SG_ temperature_max_mono : 48|8@1+ (1,-40) [-40|215] "Celcius" SLAVE
    SG_ temperature_min_mono : 56|8@1+ (1,-40) [-40|215] "Celcius" SLAVE

BO_ 403830144 CELL_VOLTAGE_SLAVE1_FRAMES: 8 MASTER
    SG_ raw_cell_voltage_frameid M : 8|8@1+ (1,0) [0|12] "" SLAVE
    SG_ raw_batt1_cell1_voltage m1 : 32|16@0+ (0.001,0) [0|6553.5] "Volts" SLAVE
    SG_ raw_batt1_cell2_voltage m1 : 16|16@0+ (0.001,0) [0|6553.5] "Volts" SLAVE
    SG_ raw_batt1_cell3_voltage m1 : 0|16@0+ (0.001,0) [0|6553.5] "Volts" SLAVE
    SG_ raw_batt1_cell4_voltage m4 : 32|16@0+ (0.001,0) [0|6553.5] "Volts" SLAVE
    SG_ raw_batt2_cell1_voltage m4 : 16|16@0+ (0.001,0) [0|6553.5] "Volts" SLAVE
    SG_ raw_batt2_cell2_voltage m4 : 0|16@0+ (0.001,0) [0|6553.5] "Volts" SLAVE
    SG_ raw_batt2_cell3_voltage m7 : 32|16@0+ (0.001,0) [0|6553.5] "Volts" SLAVE
    SG_ raw_batt2_cell4_voltage m7 : 16|16@0+ (0.001,0) [0|6553.5] "Volts" SLAVE
    SG_ raw_batt3_cell1_voltage m7 : 0|16@0+ (0.001,0) [0|6553.5] "Volts" SLAVE
    SG_ raw_batt3_cell2_voltage m10 : 32|16@0+ (0.001,0) [0|6553.5] "Volts" SLAVE
    SG_ raw_batt3_cell3_voltage m10 : 16|16@0+ (0.001,0) [0|6553.5] "Volts" SLAVE
    SG_ raw_batt3_cell4_voltage m10 : 0|16@0+ (0.001,0) [0|6553.5] "Volts" SLAVE
    SG_ raw_batt4_cell1_voltage m13 : 32|16@0+ (0.001,0) [0|6553.5] "Volts" SLAVE
    SG_ raw_batt4_cell2_voltage m13 : 16|16@0+ (0.001,0) [0|6553.5] "Volts" SLAVE
    SG_ raw_batt4_cell3_voltage m13 : 0|16@0+ (0.001,0) [0|6553.5] "Volts" SLAVE
    SG_ raw_batt4_cell4_voltage m16 : 32|16@0+ (0.001,0) [0|6553.5] "Volts" SLAVE
    SG_ raw_batt5_cell1_voltage m16 : 16|16@0+ (0.001,0) [0|6553.5] "Volts" SLAVE
    SG_ raw_batt5_cell2_voltage m16 : 0|16@0+ (0.001,0) [0|6553.5] "Volts" SLAVE
    SG_ raw_batt5_cell3_voltage m19 : 32|16@0+ (0.001,0) [0|6553.5] "Volts" SLAVE
    SG_ raw_batt5_cell4_voltage m19 : 16|16@0+ (0.001,0) [0|6553.5] "Volts" SLAVE
    SG_ raw_batt6_cell1_voltage m19 : 0|16@0+ (0.001,0) [0|6553.5] "Volts" SLAVE
    SG_ raw_batt6_cell2_voltage m22 : 32|16@0+ (0.001,0) [0|6553.5] "Volts" SLAVE
    SG_ raw_batt6_cell3_voltage m22 : 16|16@0+ (0.001,0) [0|6553.5] "Volts" SLAVE
    SG_ raw_batt6_cell4_voltage m22 : 0|16@0+ (0.001,0) [0|6553.5] "Volts" SLAVE
    SG_ raw_batt7_cell1_voltage m25 : 32|16@0+ (0.001,0) [0|6553.5] "Volts" SLAVE
    SG_ raw_batt7_cell2_voltage m25 : 16|16@0+ (0.001,0) [0|6553.5] "Volts" SLAVE
    SG_ raw_batt7_cell3_voltage m25 : 0|16@0+ (0.001,0) [0|6553.5] "Volts" SLAVE
    SG_ raw_batt7_cell4_voltage m28 : 32|16@0+ (0.001,0) [0|6553.5] "Volts" SLAVE
    SG_ raw_batt8_cell1_voltage m28 : 16|16@0+ (0.001,0) [0|6553.5] "Volts" SLAVE
    SG_ raw_batt8_cell2_voltage m28 : 0|16@0+ (0.001,0) [0|6553.5] "Volts" SLAVE
    SG_ raw_batt8_cell3_voltage m31 : 32|16@0+ (0.001,0) [0|6553.5] "Volts" SLAVE
    SG_ raw_batt8_cell4_voltage m31 : 16|16@0+ (0.001,0) [0|6553.5] "Volts" SLAVE
    SG_ raw_batt9_cell1_voltage m31 : 0|16@0+ (0.001,0) [0|6553.5] "Volts" SLAVE
    SG_ raw_batt9_cell2_voltage m34 : 32|16@0+ (0.001,0) [0|6553.5] "Volts" SLAVE
    SG_ raw_batt9_cell3_voltage m34 : 16|16@0+ (0.001,0) [0|6553.5] "Volts" SLAVE
    SG_ raw_batt9_cell4_voltage m34 : 0|16@0+ (0.001,0) [0|6553.5] "Volts" SLAVE
    SG_ raw_batt10_cell1_voltage m37 : 32|16@0+ (0.001,0) [0|6553.5] "Volts" SLAVE
    SG_ raw_batt10_cell2_voltage m37 : 16|16@0+ (0.001,0) [0|6553.5] "Volts" SLAVE
    SG_ raw_batt10_cell3_voltage m37 : 0|16@0+ (0.001,0) [0|6553.5] "Volts" SLAVE
    SG_ raw_batt10_cell4_voltage m40 : 32|16@0+ (0.001,0) [0|6553.5] "Volts" SLAVE
    SG_ raw_batt11_cell1_voltage m40 : 16|16@0+ (0.001,0) [0|6553.5] "Volts" SLAVE
    SG_ raw_batt11_cell2_voltage m40 : 0|16@0+ (0.001,0) [0|6553.5] "Volts" SLAVE
    SG_ raw_batt11_cell3_voltage m43 : 32|16@0+ (0.001,0) [0|6553.5] "Volts" SLAVE
    SG_ raw_batt11_cell4_voltage m43 : 16|16@0+ (0.001,0) [0|6553.5] "Volts" SLAVE
    SG_ raw_batt12_cell1_voltage m43 : 0|16@0+ (0.001,0) [0|6553.5] "Volts" SLAVE
    SG_ raw_batt12_cell2_voltage m46 : 32|16@0+ (0.001,0) [0|6553.5] "Volts" SLAVE
    SG_ raw_batt12_cell3_voltage m46 : 16|16@0+ (0.001,0) [0|6553.5] "Volts" SLAVE
    SG_ raw_batt12_cell4_voltage m46 : 0|16@0+ (0.001,0) [0|6553.5] "Volts" SLAVE

BO_ 403830145 CELL_VOLTAGE_SLAVE2_FRAMES: 8 MASTER
    SG_ raw_cell_voltage_frameid M : 8|8@1+ (1,0) [0|12] "" SLAVE
    SG_ raw_batt13_cell1_voltage m1 : 32|16@0+ (0.001,0) [0|6553.5] "Volts" SLAVE
    SG_ raw_batt13_cell2_voltage m1 : 16|16@0+ (0.001,0) [0|6553.5] "Volts" SLAVE
    SG_ raw_batt13_cell3_voltage m1 : 0|16@0+ (0.001,0) [0|6553.5] "Volts" SLAVE
    SG_ raw_batt13_cell4_voltage m4 : 32|16@0+ (0.001,0) [0|6553.5] "Volts" SLAVE
    SG_ raw_batt14_cell1_voltage m4 : 16|16@0+ (0.001,0) [0|6553.5] "Volts" SLAVE
    SG_ raw_batt14_cell2_voltage m4 : 0|16@0+ (0.001,0) [0|6553.5] "Volts" SLAVE
    SG_ raw_batt14_cell3_voltage m7 : 32|16@0+ (0.001,0) [0|6553.5] "Volts" SLAVE
    SG_ raw_batt14_cell4_voltage m7 : 16|16@0+ (0.001,0) [0|6553.5] "Volts" SLAVE
    SG_ raw_batt15_cell1_voltage m7 : 0|16@0+ (0.001,0) [0|6553.5] "Volts" SLAVE
    SG_ raw_batt15_cell2_voltage m10 : 32|16@0+ (0.001,0) [0|6553.5] "Volts" SLAVE
    SG_ raw_batt15_cell3_voltage m10 : 16|16@0+ (0.001,0) [0|6553.5] "Volts" SLAVE
    SG_ raw_batt15_cell4_voltage m10 : 0|16@0+ (0.001,0) [0|6553.5] "Volts" SLAVE
    SG_ raw_batt16_cell1_voltage m13 : 32|16@0+ (0.001,0) [0|6553.5] "Volts" SLAVE
    SG_ raw_batt16_cell2_voltage m13 : 16|16@0+ (0.001,0) [0|6553.5] "Volts" SLAVE
    SG_ raw_batt16_cell3_voltage m13 : 0|16@0+ (0.001,0) [0|6553.5] "Volts" SLAVE
    SG_ raw_batt16_cell4_voltage m16 : 32|16@0+ (0.001,0) [0|6553.5] "Volts" SLAVE
    SG_ raw_batt17_cell1_voltage m16 : 16|16@0+ (0.001,0) [0|6553.5] "Volts" SLAVE
    SG_ raw_batt17_cell2_voltage m16 : 0|16@0+ (0.001,0) [0|6553.5] "Volts" SLAVE
    SG_ raw_batt17_cell3_voltage m19 : 32|16@0+ (0.001,0) [0|6553.5] "Volts" SLAVE
    SG_ raw_batt17_cell4_voltage m19 : 16|16@0+ (0.001,0) [0|6553.5] "Volts" SLAVE
    SG_ raw_batt18_cell1_voltage m19 : 0|16@0+ (0.001,0) [0|6553.5] "Volts" SLAVE
    SG_ raw_batt18_cell2_voltage m22 : 32|16@0+ (0.001,0) [0|6553.5] "Volts" SLAVE
    SG_ raw_batt18_cell3_voltage m22 : 16|16@0+ (0.001,0) [0|6553.5] "Volts" SLAVE
    SG_ raw_batt18_cell4_voltage m22 : 0|16@0+ (0.001,0) [0|6553.5] "Volts" SLAVE
    SG_ raw_batt19_cell1_voltage m25 : 32|16@0+ (0.001,0) [0|6553.5] "Volts" SLAVE
    SG_ raw_batt19_cell2_voltage m25 : 16|16@0+ (0.001,0) [0|6553.5] "Volts" SLAVE
    SG_ raw_batt19_cell3_voltage m25 : 0|16@0+ (0.001,0) [0|6553.5] "Volts" SLAVE
    SG_ raw_batt19_cell4_voltage m28 : 32|16@0+ (0.001,0) [0|6553.5] "Volts" SLAVE

BO_ 403830146 CELL_VOLTAGE_SLAVE3_FRAMES: 8 MASTER
    SG_ raw_cell_voltage_frameid M : 8|8@1+ (1,0) [0|12] "" SLAVE
    SG_ raw_batt20_cell1_voltage m1 : 32|16@0+ (0.001,0) [0|6553.5] "Volts" SLAVE
    SG_ raw_batt20_cell2_voltage m1 : 16|16@0+ (0.001,0) [0|6553.5] "Volts" SLAVE
    SG_ raw_batt20_cell3_voltage m1 : 0|16@0+ (0.001,0) [0|6553.5] "Volts" SLAVE
    SG_ raw_batt20_cell4_voltage m4 : 32|16@0+ (0.001,0) [0|6553.5] "Volts" SLAVE
    SG_ raw_batt21_cell1_voltage m4 : 16|16@0+ (0.001,0) [0|6553.5] "Volts" SLAVE
    SG_ raw_batt21_cell2_voltage m4 : 0|16@0+ (0.001,0) [0|6553.5] "Volts" SLAVE
    SG_ raw_batt21_cell3_voltage m7 : 32|16@0+ (0.001,0) [0|6553.5] "Volts" SLAVE
    SG_ raw_batt21_cell4_voltage m7 : 16|16@0+ (0.001,0) [0|6553.5] "Volts" SLAVE
    SG_ raw_batt22_cell1_voltage m7 : 0|16@0+ (0.001,0) [0|6553.5] "Volts" SLAVE
    SG_ raw_batt22_cell2_voltage m10 : 32|16@0+ (0.001,0) [0|6553.5] "Volts" SLAVE
    SG_ raw_batt22_cell3_voltage m10 : 16|16@0+ (0.001,0) [0|6553.5] "Volts" SLAVE
    SG_ raw_batt22_cell4_voltage m10 : 0|16@0+ (0.001,0) [0|6553.5] "Volts" SLAVE
    SG_ raw_batt23_cell1_voltage m13 : 32|16@0+ (0.001,0) [0|6553.5] "Volts" SLAVE
    SG_ raw_batt23_cell2_voltage m13 : 16|16@0+ (0.001,0) [0|6553.5] "Volts" SLAVE
    SG_ raw_batt23_cell3_voltage m13 : 0|16@0+ (0.001,0) [0|6553.5] "Volts" SLAVE
    SG_ raw_batt23_cell4_voltage m16 : 32|16@0+ (0.001,0) [0|6553.5] "Volts" SLAVE
    SG_ raw_batt24_cell1_voltage m16 : 16|16@0+ (0.001,0) [0|6553.5] "Volts" SLAVE
    SG_ raw_batt24_cell2_voltage m16 : 0|16@0+ (0.001,0) [0|6553.5] "Volts" SLAVE
    SG_ raw_batt24_cell3_voltage m19 : 32|16@0+ (0.001,0) [0|6553.5] "Volts" SLAVE
    SG_ raw_batt24_cell4_voltage m19 : 16|16@0+ (0.001,0) [0|6553.5] "Volts" SLAVE
    SG_ raw_batt25_cell1_voltage m19 : 0|16@0+ (0.001,0) [0|6553.5] "Volts" SLAVE
    SG_ raw_batt25_cell2_voltage m22 : 32|16@0+ (0.001,0) [0|6553.5] "Volts" SLAVE
    SG_ raw_batt25_cell3_voltage m22 : 16|16@0+ (0.001,0) [0|6553.5] "Volts" SLAVE
    SG_ raw_batt25_cell4_voltage m22 : 0|16@0+ (0.001,0) [0|6553.5] "Volts" SLAVE
    SG_ raw_batt26_cell1_voltage m25 : 32|16@0+ (0.001,0) [0|6553.5] "Volts" SLAVE
    SG_ raw_batt26_cell2_voltage m25 : 16|16@0+ (0.001,0) [0|6553.5] "Volts" SLAVE
    SG_ raw_batt26_cell3_voltage m25 : 0|16@0+ (0.001,0) [0|6553.5] "Volts" SLAVE
    SG_ raw_batt26_cell4_voltage m28 : 32|16@0+ (0.001,0) [0|6553.5] "Volts" SLAVE

BO_ 403830144 CELL_VOLTAGE_SLAVE4_FRAMES: 8 MASTER
    SG_ raw_cell_voltage_frameid M : 8|8@1+ (1,0) [0|12] "" SLAVE
    SG_ raw_batt27_cell1_voltage m1 : 32|16@0+ (0.001,0) [0|6553.5] "Volts" SLAVE
    SG_ raw_batt27_cell2_voltage m1 : 16|16@0+ (0.001,0) [0|6553.5] "Volts" SLAVE
    SG_ raw_batt27_cell3_voltage m1 : 0|16@0+ (0.001,0) [0|6553.5] "Volts" SLAVE
    SG_ raw_batt27_cell4_voltage m4 : 32|16@0+ (0.001,0) [0|6553.5] "Volts" SLAVE
    SG_ raw_batt28_cell1_voltage m4 : 16|16@0+ (0.001,0) [0|6553.5] "Volts" SLAVE
    SG_ raw_batt28_cell2_voltage m4 : 0|16@0+ (0.001,0) [0|6553.5] "Volts" SLAVE
    SG_ raw_batt28_cell3_voltage m7 : 32|16@0+ (0.001,0) [0|6553.5] "Volts" SLAVE
    SG_ raw_batt28_cell4_voltage m7 : 16|16@0+ (0.001,0) [0|6553.5] "Volts" SLAVE
    SG_ raw_batt29_cell1_voltage m7 : 0|16@0+ (0.001,0) [0|6553.5] "Volts" SLAVE
    SG_ raw_batt29_cell2_voltage m10 : 32|16@0+ (0.001,0) [0|6553.5] "Volts" SLAVE
    SG_ raw_batt29_cell3_voltage m10 : 16|16@0+ (0.001,0) [0|6553.5] "Volts" SLAVE
    SG_ raw_batt29_cell4_voltage m10 : 0|16@0+ (0.001,0) [0|6553.5] "Volts" SLAVE
    SG_ raw_batt30_cell1_voltage m13 : 32|16@0+ (0.001,0) [0|6553.5] "Volts" SLAVE
    SG_ raw_batt30_cell2_voltage m13 : 16|16@0+ (0.001,0) [0|6553.5] "Volts" SLAVE
    SG_ raw_batt30_cell3_voltage m13 : 0|16@0+ (0.001,0) [0|6553.5] "Volts" SLAVE
    SG_ raw_batt30_cell4_voltage m16 : 32|16@0+ (0.001,0) [0|6553.5] "Volts" SLAVE
    SG_ raw_batt31_cell1_voltage m16 : 16|16@0+ (0.001,0) [0|6553.5] "Volts" SLAVE
    SG_ raw_batt31_cell2_voltage m16 : 0|16@0+ (0.001,0) [0|6553.5] "Volts" SLAVE
    SG_ raw_batt31_cell3_voltage m19 : 32|16@0+ (0.001,0) [0|6553.5] "Volts" SLAVE
    SG_ raw_batt31_cell4_voltage m19 : 16|16@0+ (0.001,0) [0|6553.5] "Volts" SLAVE
    SG_ raw_batt32_cell1_voltage m19 : 0|16@0+ (0.001,0) [0|6553.5] "Volts" SLAVE
    SG_ raw_batt32_cell2_voltage m22 : 32|16@0+ (0.001,0) [0|6553.5] "Volts" SLAVE
    SG_ raw_batt32_cell3_voltage m22 : 16|16@0+ (0.001,0) [0|6553.5] "Volts" SLAVE
    SG_ raw_batt32_cell4_voltage m22 : 0|16@0+ (0.001,0) [0|6553.5] "Volts" SLAVE
    SG_ raw_batt33_cell1_voltage m25 : 32|16@0+ (0.001,0) [0|6553.5] "Volts" SLAVE
    SG_ raw_batt33_cell2_voltage m25 : 16|16@0+ (0.001,0) [0|6553.5] "Volts" SLAVE
    SG_ raw_batt33_cell3_voltage m25 : 0|16@0+ (0.001,0) [0|6553.5] "Volts" SLAVE
    SG_ raw_batt33_cell4_voltage m28 : 32|16@0+ (0.001,0) [0|6553.5] "Volts" SLAVE
    SG_ raw_batt34_cell1_voltage m28 : 16|16@0+ (0.001,0) [0|6553.5] "Volts" SLAVE
    SG_ raw_batt34_cell2_voltage m28 : 0|16@0+ (0.001,0) [0|6553.5] "Volts" SLAVE
    SG_ raw_batt34_cell3_voltage m31 : 32|16@0+ (0.001,0) [0|6553.5] "Volts" SLAVE
    SG_ raw_batt34_cell4_voltage m31 : 16|16@0+ (0.001,0) [0|6553.5] "Volts" SLAVE
    SG_ raw_batt35_cell1_voltage m31 : 0|16@0+ (0.001,0) [0|6553.5] "Volts" SLAVE
    SG_ raw_batt35_cell2_voltage m34 : 32|16@0+ (0.001,0) [0|6553.5] "Volts" SLAVE
    SG_ raw_batt35_cell3_voltage m34 : 16|16@0+ (0.001,0) [0|6553.5] "Volts" SLAVE
    SG_ raw_batt35_cell4_voltage m34 : 0|16@0+ (0.001,0) [0|6553.5] "Volts" SLAVE
    SG_ raw_batt36_cell1_voltage m37 : 32|16@0+ (0.001,0) [0|6553.5] "Volts" SLAVE
    SG_ raw_batt36_cell2_voltage m37 : 16|16@0+ (0.001,0) [0|6553.5] "Volts" SLAVE
    SG_ raw_batt36_cell3_voltage m37 : 0|16@0+ (0.001,0) [0|6553.5] "Volts" SLAVE
    SG_ raw_batt36_cell4_voltage m40 : 32|16@0+ (0.001,0) [0|6553.5] "Volts" SLAVE
    SG_ raw_batt37_cell1_voltage m40 : 16|16@0+ (0.001,0) [0|6553.5] "Volts" SLAVE
    SG_ raw_batt37_cell2_voltage m40 : 0|16@0+ (0.001,0) [0|6553.5] "Volts" SLAVE
    SG_ raw_batt37_cell3_voltage m43 : 32|16@0+ (0.001,0) [0|6553.5] "Volts" SLAVE
    SG_ raw_batt37_cell4_voltage m43 : 16|16@0+ (0.001,0) [0|6553.5] "Volts" SLAVE
    SG_ raw_batt38_cell1_voltage m43 : 0|16@0+ (0.001,0) [0|6553.5] "Volts" SLAVE
    SG_ raw_batt38_cell2_voltage m46 : 32|16@0+ (0.001,0) [0|6553.5] "Volts" SLAVE
    SG_ raw_batt38_cell3_voltage m46 : 16|16@0+ (0.001,0) [0|6553.5] "Volts" SLAVE
    SG_ raw_batt38_cell4_voltage m46 : 0|16@0+ (0.001,0) [0|6553.5] "Volts" SLAVE

BO_ 405927144 CELL_VOLTAGE_FRAMES: 8 MASTER
    SG_ raw_mb_voltage_frameid M : 8|8@1+ (1,0) [0|12] "" SLAVE
    SG_ raw_mb1_voltage m1 : 32|16@0+ (0.001,0) [0|6553.5] "Volts" SLAVE
    SG_ raw_mb2_voltage m1 : 16|16@0+ (0.001,0) [0|6553.5] "Volts" SLAVE
    SG_ raw_mb3_voltage m1 : 0|16@0+ (0.001,0) [0|6553.5] "Volts" SLAVE
    SG_ raw_mb4_voltage m2 : 32|16@0+ (0.001,0) [0|6553.5] "Volts" SLAVE
    SG_ raw_mb5_voltage m2 : 16|16@0+ (0.001,0) [0|6553.5] "Volts" SLAVE
    SG_ raw_mb6_voltage m2 : 0|16@0+ (0.001,0) [0|6553.5] "Volts" SLAVE
    SG_ raw_mb7_voltage m3 : 32|16@0+ (0.001,0) [0|6553.5] "Volts" SLAVE
    SG_ raw_mb8_voltage m3 : 16|16@0+ (0.001,0) [0|6553.5] "Volts" SLAVE
    SG_ raw_mb9_voltage m3 : 0|16@0+ (0.001,0) [0|6553.5] "Volts" SLAVE
    SG_ raw_mb10_voltage m4 : 32|16@0+ (0.001,0) [0|6553.5] "Volts" SLAVE
    SG_ raw_mb11_voltage m4 : 16|16@0+ (0.001,0) [0|6553.5] "Volts" SLAVE
    SG_ raw_mb12_voltage m4 : 0|16@0+ (0.001,0) [0|6553.5] "Volts" SLAVE
    SG_ raw_mb13_voltage m5 : 32|16@0+ (0.001,0) [0|6553.5] "Volts" SLAVE
    SG_ raw_mb14_voltage m5 : 16|16@0+ (0.001,0) [0|6553.5] "Volts" SLAVE
    SG_ raw_mb15_voltage m5 : 0|16@0+ (0.001,0) [0|6553.5] "Volts" SLAVE
    SG_ raw_mb16_voltage m6 : 32|16@0+ (0.001,0) [0|6553.5] "Volts" SLAVE
    SG_ raw_mb17_voltage m6 : 16|16@0+ (0.001,0) [0|6553.5] "Volts" SLAVE
    SG_ raw_mb18_voltage m6 : 0|16@0+ (0.001,0) [0|6553.5] "Volts" SLAVE
    SG_ raw_mb19_voltage m7 : 32|16@0+ (0.001,0) [0|6553.5] "Volts" SLAVE
    SG_ raw_mb20_voltage m7 : 16|16@0+ (0.001,0) [0|6553.5] "Volts" SLAVE
    SG_ raw_mb21_voltage m7 : 0|16@0+ (0.001,0) [0|6553.5] "Volts" SLAVE
    SG_ raw_mb22_voltage m8 : 32|16@0+ (0.001,0) [0|6553.5] "Volts" SLAVE
    SG_ raw_mb23_voltage m8 : 16|16@0+ (0.001,0) [0|6553.5] "Volts" SLAVE
    SG_ raw_mb24_voltage m8 : 0|16@0+ (0.001,0) [0|6553.5] "Volts" SLAVE
    SG_ raw_mb25_voltage m9 : 32|16@0+ (0.001,0) [0|6553.5] "Volts" SLAVE
    SG_ raw_mb26_voltage m9 : 16|16@0+ (0.001,0) [0|6553.5] "Volts" SLAVE
    SG_ raw_mb27_voltage m9 : 0|16@0+ (0.001,0) [0|6553.5] "Volts" SLAVE
    SG_ raw_mb28_voltage m10 : 32|16@0+ (0.001,0) [0|6553.5] "Volts" SLAVE
    SG_ raw_mb29_voltage m10 : 16|16@0+ (0.001,0) [0|6553.5] "Volts" SLAVE
    SG_ raw_mb30_voltage m10 : 0|16@0+ (0.001,0) [0|6553.5] "Volts" SLAVE
    SG_ raw_mb31_voltage m11 : 32|16@0+ (0.001,0) [0|6553.5] "Volts" SLAVE
    SG_ raw_mb32_voltage m11 : 16|16@0+ (0.001,0) [0|6553.5] "Volts" SLAVE
    SG_ raw_mb33_voltage m11 : 0|16@0+ (0.001,0) [0|6553.5] "Volts" SLAVE
    SG_ raw_mb34_voltage m12 : 32|16@0+ (0.001,0) [0|6553.5] "Volts" SLAVE
    SG_ raw_mb35_voltage m12 : 16|16@0+ (0.001,0) [0|6553.5] "Volts" SLAVE
    SG_ raw_mb36_voltage m12 : 0|16@0+ (0.001,0) [0|6553.5] "Volts" SLAVE
    SG_ raw_mb37_voltage m13 : 32|16@0+ (0.001,0) [0|6553.5] "Volts" SLAVE
    SG_ raw_mb38_voltage m13 : 16|16@0+ (0.001,0) [0|6553.5] "Volts" SLAVE
    SG_ raw_mb39_voltage m13 : 0|16@0+ (0.001,0) [0|6553.5] "Volts" SLAVE
    SG_ raw_mb40_voltage m14 : 32|16@0+ (0.001,0) [0|6553.5] "Volts" SLAVE
    SG_ raw_mb41_voltage m14 : 16|16@0+ (0.001,0) [0|6553.5] "Volts" SLAVE
    SG_ raw_mb42_voltage m14 : 0|16@0+ (0.001,0) [0|6553.5] "Volts" SLAVE
    SG_ raw_mb43_voltage m15 : 32|16@0+ (0.001,0) [0|6553.5] "Volts" SLAVE
    SG_ raw_mb44_voltage m15 : 16|16@0+ (0.001,0) [0|6553.5] "Volts" SLAVE
    SG_ raw_mb45_voltage m15 : 0|16@0+ (0.001,0) [0|6553.5] "Volts" SLAVE
    SG_ raw_mb46_voltage m16 : 32|16@0+ (0.001,0) [0|6553.5] "Volts" SLAVE
    SG_ raw_mb47_voltage m16 : 16|16@0+ (0.001,0) [0|6553.5] "Volts" SLAVE
    SG_ raw_mb48_voltage m16 : 0|16@0+ (0.001,0) [0|6553.5] "Volts" SLAVE
    SG_ raw_mb49_voltage m17 : 32|16@0+ (0.001,0) [0|6553.5] "Volts" SLAVE
    SG_ raw_mb50_voltage m17 : 16|16@0+ (0.001,0) [0|6553.5] "Volts" SLAVE
    SG_ raw_mb51_voltage m17 : 0|16@0+ (0.001,0) [0|6553.5] "Volts" SLAVE
    SG_ raw_mb52_voltage m18 : 32|16@0+ (0.001,0) [0|6553.5] "Volts" SLAVE
    SG_ raw_mb53_voltage m18 : 16|16@0+ (0.001,0) [0|6553.5] "Volts" SLAVE
    SG_ raw_mb54_voltage m18 : 0|16@0+ (0.001,0) [0|6553.5] "Volts" SLAVE
    SG_ raw_mb55_voltage m19 : 32|16@0+ (0.001,0) [0|6553.5] "Volts" SLAVE
    SG_ raw_mb56_voltage m19 : 16|16@0+ (0.001,0) [0|6553.5] "Volts" SLAVE
    SG_ raw_mb57_voltage m19 : 0|16@0+ (0.001,0) [0|6553.5] "Volts" SLAVE
    SG_ raw_mb58_voltage m20 : 32|16@0+ (0.001,0) [0|6553.5] "Volts" SLAVE
    SG_ raw_mb59_voltage m20 : 16|16@0+ (0.001,0) [0|6553.5] "Volts" SLAVE
    SG_ raw_mb60_voltage m20 : 0|16@0+ (0.001,0) [0|6553.5] "Volts" SLAVE

BO_ 406899944 POWER_CURRENT: 8 MASTER
    SG_ power_instant : 0|16@0+ (0.1,-1600) [-1600|4953.5] "Watt-Hours" SLAVE
    SG_ power_cumulative : 48|16@0+ (0.1,-1600) [-1600|4953.5] "Watt-Hours" SLAVE
    SG_ current_hall : 16|16@0+ (0.1,-1600) [-1600|4953.5] "Amps" SLAVE
    SG_ current_shunt : 0|16@0+ (0.1,-1600) [-1600|4953.5] "Amps" SLAVE

BO_ 406834408 SOC_CURRENT: 8 MASTER
    SG_ state_current_num : 0|8@1+ (1,0) [0|7] "STATE" SLAVE
    SG_ soc : 8|8@1+ (1,0) [0|100] "Percent" SLAVE
    SG_ input_1 : 16|1@1+ (1,0) [0|0] "" SLAVE
    SG_ input_2 : 17|1@1+ (1,0) [0|0] "" SLAVE
    SG_ input_3 : 18|1@1+ (1,0) [0|0] "" SLAVE
    SG_ input_4 : 19|1@1+ (1,0) [0|0] "" SLAVE
    SG_ input_5 : 20|1@1+ (1,0) [0|0] "" SLAVE
    SG_ input_6 : 21|1@1+ (1,0) [0|0] "" SLAVE
    SG_ input_7 : 22|1@1+ (1,0) [0|0] "" SLAVE
    SG_ input_8 : 23|1@1+ (1,0) [0|0] "" SLAVE
    SG_ output_1 : 24|1@1+ (1,0) [0|0] "" SLAVE
    SG_ output_2 : 25|1@1+ (1,0) [0|0] "" SLAVE
    SG_ output_3 : 26|1@1+ (1,0) [0|0] "" SLAVE
    SG_ output_4 : 27|1@1+ (1,0) [0|0] "" SLAVE
    SG_ output_5 : 28|1@1+ (1,0) [0|0] "" SLAVE
    SG_ output_6 : 29|1@1+ (1,0) [0|0] "" SLAVE
    SG_ output_7 : 30|1@1+ (1,0) [0|0] "" SLAVE
    SG_ output_8 : 31|1@1+ (1,0) [0|0] "" SLAVE
    SG_ voltage_stack : 16|16@0+ (0.1,0) [0|6553.5] "Volts" SLAVE
    SG_ current_system : 0|16@0+ (0.1,-1600) [-1600|4953.5] "Amps" SLAVE

BO_ 406637800 DEBUG_FRAME: 8 MASTER
    SG_ debug_frame_id M : 0|8@1+ (1,0) [0|0] "" SLAVE
    SG_ voltage_hv1 m4 : 8|16@1+ (0.1,0) [0|6553.5] "Volts" SLAVE
    SG_ voltage_hv2 m4 : 24|16@1+ (0.1,0) [0|6553.5] "Volts" SLAVE
    SG_ voltage_supply m4 : 40|16@1+ (0.1,0) [0|6553.5] "Volts" SLAVE

BO_ 406113512 RAW_FRAME: 8 MASTER
    SG_ raw_frameid M : 0|8@1+ (1,0) [0|7] "" SLAVE
    SG_ raw_state_present_num m1 : 8|8@1+ (1,0) [0|7] "STATE" SLAVE
    SG_ raw_state_previous_num m1 : 16|8@1+ (1,0) [0|7] "STATE" SLAVE
    SG_ raw_state_historic_num m1 : 24|8@1+ (1,0) [0|7] "STATE" SLAVE
    SG_ raw_temperature_system m1 : 40|8@1+ (1,-40) [-40|215] "Celcius" SLAVE
    SG_ raw_state_error_message m1 : 32|8@1+ (1,0) [0|25] "" SLAVE
    SG_ raw_temperature_diode m1 : 48|8@1+ (1,-40) [-40|215] "Celcius" SLAVE
    SG_ raw_temperature_contactor m1 : 56|8@1+ (1,-40) [-40|215] "Celcius" SLAVE
    SG_ raw_current_system m2 : 8|16@0+ (0.1,-1600) [-1600|4953.5] "Amps" SLAVE
    SG_ raw_current_hall m2 : 24|16@0+ (0.1,-1600) [-1600|4953.5] "Amps" SLAVE
    SG_ raw_current_shunt m2 : 40|16@0+ (0.1,-1600) [-1600|4953.5] "Amps" SLAVE
    SG_ raw_soc m2 : 56|8@1+ (1,0) [0|100] "Percent" SLAVE
    SG_ raw_k_value m3 : 8|16@0+ (1,0) [0|65535] "" SLAVE
    SG_ raw_voltage_inverter m3 : 24|16@0+ (0.1,0) [0|6553.5] "Volts" SLAVE
    SG_ raw_voltage_supply m3 : 40|16@0+ (0.1,0) [0|6553.5] "Volts" SLAVE
    SG_ raw_soh m3 : 56|8@1+ (1,0) [0|100] "Percent" SLAVE
    SG_ raw_discharge_cumulative m4 : 8|16@0+ (0.1,-1600) [-1600|4953.5] "Amp-Hours" SLAVE
    SG_ raw_discharge_absolute m4 : 24|16@0+ (0.1,-1600) [-1600|4953.5] "Amp-Hours" SLAVE
    SG_ raw_months_of_service m4 : 40|16@0+ (0.1,-1600) [-1600|4953.5] "Months" SLAVE

BO_ 405851368 MONOBLOCK_VOLTAGE_FRAMES: 8 MASTER
    SG_ raw_mb_voltage_frameid M : 0|8@1+ (1,0) [0|12] "" SLAVE
    SG_ raw_mb1_voltage m1 : 32|16@0+ (0.001,0) [0|6553.5] "Volts" SLAVE
    SG_ raw_mb2_voltage m1 : 16|16@0+ (0.001,0) [0|6553.5] "Volts" SLAVE
    SG_ raw_mb3_voltage m1 : 0|16@0+ (0.001,0) [0|6553.5] "Volts" SLAVE
    SG_ raw_mb4_voltage m2 : 32|16@0+ (0.001,0) [0|6553.5] "Volts" SLAVE
    SG_ raw_mb5_voltage m2 : 16|16@0+ (0.001,0) [0|6553.5] "Volts" SLAVE
    SG_ raw_mb6_voltage m2 : 0|16@0+ (0.001,0) [0|6553.5] "Volts" SLAVE
    SG_ raw_mb7_voltage m3 : 32|16@0+ (0.001,0) [0|6553.5] "Volts" SLAVE
    SG_ raw_mb8_voltage m3 : 16|16@0+ (0.001,0) [0|6553.5] "Volts" SLAVE
    SG_ raw_mb9_voltage m3 : 0|16@0+ (0.001,0) [0|6553.5] "Volts" SLAVE
    SG_ raw_mb10_voltage m4 : 32|16@0+ (0.001,0) [0|6553.5] "Volts" SLAVE
    SG_ raw_mb11_voltage m4 : 16|16@0+ (0.001,0) [0|6553.5] "Volts" SLAVE
    SG_ raw_mb12_voltage m4 : 0|16@0+ (0.001,0) [0|6553.5] "Volts" SLAVE
    SG_ raw_mb13_voltage m5 : 32|16@0+ (0.001,0) [0|6553.5] "Volts" SLAVE
    SG_ raw_mb14_voltage m5 : 16|16@0+ (0.001,0) [0|6553.5] "Volts" SLAVE
    SG_ raw_mb15_voltage m5 : 0|16@0+ (0.001,0) [0|6553.5] "Volts" SLAVE
    SG_ raw_mb16_voltage m6 : 32|16@0+ (0.001,0) [0|6553.5] "Volts" SLAVE
    SG_ raw_mb17_voltage m6 : 16|16@0+ (0.001,0) [0|6553.5] "Volts" SLAVE
    SG_ raw_mb18_voltage m6 : 0|16@0+ (0.001,0) [0|6553.5] "Volts" SLAVE
    SG_ raw_mb19_voltage m7 : 32|16@0+ (0.001,0) [0|6553.5] "Volts" SLAVE
    SG_ raw_mb20_voltage m7 : 16|16@0+ (0.001,0) [0|6553.5] "Volts" SLAVE
    SG_ raw_mb21_voltage m7 : 0|16@0+ (0.001,0) [0|6553.5] "Volts" SLAVE
    SG_ raw_mb22_voltage m8 : 32|16@0+ (0.001,0) [0|6553.5] "Volts" SLAVE
    SG_ raw_mb23_voltage m8 : 16|16@0+ (0.001,0) [0|6553.5] "Volts" SLAVE
    SG_ raw_mb24_voltage m8 : 0|16@0+ (0.001,0) [0|6553.5] "Volts" SLAVE
    SG_ raw_mb25_voltage m9 : 32|16@0+ (0.001,0) [0|6553.5] "Volts" SLAVE
    SG_ raw_mb26_voltage m9 : 16|16@0+ (0.001,0) [0|6553.5] "Volts" SLAVE
    SG_ raw_mb27_voltage m9 : 0|16@0+ (0.001,0) [0|6553.5] "Volts" SLAVE
    SG_ raw_mb28_voltage m10 : 32|16@0+ (0.001,0) [0|6553.5] "Volts" SLAVE
    SG_ raw_mb29_voltage m10 : 16|16@0+ (0.001,0) [0|6553.5] "Volts" SLAVE
    SG_ raw_mb30_voltage m10 : 0|16@0+ (0.001,0) [0|6553.5] "Volts" SLAVE
    SG_ raw_mb31_voltage m11 : 32|16@0+ (0.001,0) [0|6553.5] "Volts" SLAVE
    SG_ raw_mb32_voltage m11 : 16|16@0+ (0.001,0) [0|6553.5] "Volts" SLAVE
    SG_ raw_mb33_voltage m11 : 0|16@0+ (0.001,0) [0|6553.5] "Volts" SLAVE
    SG_ raw_mb34_voltage m12 : 32|16@0+ (0.001,0) [0|6553.5] "Volts" SLAVE
    SG_ raw_mb35_voltage m12 : 16|16@0+ (0.001,0) [0|6553.5] "Volts" SLAVE
    SG_ raw_mb36_voltage m12 : 0|16@0+ (0.001,0) [0|6553.5] "Volts" SLAVE
    SG_ raw_mb37_voltage m13 : 32|16@0+ (0.001,0) [0|6553.5] "Volts" SLAVE
    SG_ raw_mb38_voltage m13 : 16|16@0+ (0.001,0) [0|6553.5] "Volts" SLAVE

BO_ 405916904 MONOBLOCK_TEMPERATURE_FRAMES: 8 MASTER
    SG_ raw_mb_temp_frameid M : 0|8@1+ (1,0) [0|12] "" SLAVE
    SG_ raw_mb1_temp m1 : 16|8@1+ (1,-40) [-40|215] "Celcius" SLAVE
    SG_ raw_mb2_temp m1 : 24|8@1+ (1,-40) [-40|215] "Celcius" SLAVE
    SG_ raw_mb3_temp m1 : 32|8@1+ (1,-40) [-40|215] "Celcius" SLAVE
    SG_ raw_mb4_temp m1 : 40|8@1+ (1,-40) [-40|215] "Celcius" SLAVE
    SG_ raw_mb5_temp m1 : 48|8@1+ (1,-40) [-40|215] "Celcius" SLAVE
    SG_ raw_mb6_temp m1 : 56|8@1+ (1,-40) [-40|215] "Celcius" SLAVE
    SG_ raw_mb7_temp m2 : 16|8@1+ (1,-40) [-40|215] "Celcius" SLAVE
    SG_ raw_mb8_temp m2 : 24|8@1+ (1,-40) [-40|215] "Celcius" SLAVE
    SG_ raw_mb9_temp m2 : 32|8@1+ (1,-40) [-40|215] "Celcius" SLAVE
    SG_ raw_mb10_temp m2 : 40|8@1+ (1,-40) [-40|215] "Celcius" SLAVE
    SG_ raw_mb11_temp m2 : 48|8@1+ (1,-40) [-40|215] "Celcius" SLAVE
    SG_ raw_mb12_temp m2 : 56|8@1+ (1,-40) [-40|215] "Celcius" SLAVE
    SG_ raw_mb13_temp m3 : 16|8@1+ (1,-40) [-40|215] "Celcius" SLAVE
    SG_ raw_mb14_temp m3 : 24|8@1+ (1,-40) [-40|215] "Celcius" SLAVE
    SG_ raw_mb15_temp m3 : 32|8@1+ (1,-40) [-40|215] "Celcius" SLAVE
    SG_ raw_mb16_temp m3 : 40|8@1+ (1,-40) [-40|215] "Celcius" SLAVE
    SG_ raw_mb17_temp m3 : 48|8@1+ (1,-40) [-40|215] "Celcius" SLAVE
    SG_ raw_mb18_temp m3 : 56|8@1+ (1,-40) [-40|215] "Celcius" SLAVE
    SG_ raw_mb19_temp m4 : 16|8@1+ (1,-40) [-40|215] "Celcius" SLAVE
    SG_ raw_mb20_temp m4 : 24|8@1+ (1,-40) [-40|215] "Celcius" SLAVE
    SG_ raw_mb21_temp m4 : 32|8@1+ (1,-40) [-40|215] "Celcius" SLAVE
    SG_ raw_mb22_temp m4 : 40|8@1+ (1,-40) [-40|215] "Celcius" SLAVE
    SG_ raw_mb23_temp m4 : 48|8@1+ (1,-40) [-40|215] "Celcius" SLAVE
    SG_ raw_mb24_temp m4 : 56|8@1+ (1,-40) [-40|215] "Celcius" SLAVE
    SG_ raw_mb25_temp m5 : 16|8@1+ (1,-40) [-40|215] "Celcius" SLAVE
    SG_ raw_mb26_temp m5 : 24|8@1+ (1,-40) [-40|215] "Celcius" SLAVE
    SG_ raw_mb27_temp m5 : 32|8@1+ (1,-40) [-40|215] "Celcius" SLAVE
    SG_ raw_mb28_temp m5 : 40|8@1+ (1,-40) [-40|215] "Celcius" SLAVE
    SG_ raw_mb29_temp m5 : 48|8@1+ (1,-40) [-40|215] "Celcius" SLAVE
    SG_ raw_mb30_temp m5 : 56|8@1+ (1,-40) [-40|215] "Celcius" SLAVE
    SG_ raw_mb31_temp m6 : 16|8@1+ (1,-40) [-40|215] "Celcius" SLAVE
    SG_ raw_mb32_temp m6 : 24|8@1+ (1,-40) [-40|215] "Celcius" SLAVE
    SG_ raw_mb33_temp m6 : 32|8@1+ (1,-40) [-40|215] "Celcius" SLAVE
    SG_ raw_mb34_temp m6 : 40|8@1+ (1,-40) [-40|215] "Celcius" SLAVE
    SG_ raw_mb35_temp m6 : 48|8@1+ (1,-40) [-40|215] "Celcius" SLAVE
    SG_ raw_mb36_temp m6 : 56|8@1+ (1,-40) [-40|215] "Celcius" SLAVE
    SG_ raw_mb37_temp m7 : 16|8@1+ (1,-40) [-40|215] "Celcius" SLAVE
    SG_ raw_mb38_temp m7 : 24|8@1+ (1,-40) [-40|215] "Celcius" SLAVE

BO_ 406375656 STATE_MACHINE_DEBUG_FRAMES: 8 MASTER
BO_ 406703336 ERROR_FRAME: 8 MASTER

CM_ BO_ 406768872 "Temp Voltage Frame 183ECCE8";
CM_ SG_ 406768872 temperature_diode "Diode temperature";
CM_ SG_ 406768872 temperature_contactor "Contactor temperature";
CM_ SG_ 406768872 temperature_max_mono "Maximum monoblock temperature";
CM_ SG_ 406768872 temperature_min_mono "Minimum monoblock temperature";
CM_ SG_ 406768872 voltage_max_mono "Maximum monoblock voltage";
CM_ SG_ 406768872 voltage_min_mono "Minimum monoblock voltage";

CM_ BO_ 406899944 "Power Current Frame 1840CCE8";
CM_ SG_ 406899944 power_instant "Instant power";
CM_ SG_ 406899944 power_cumulative "Cumulative power";
CM_ SG_ 406899944 current_hall "Hall effect current";
CM_ SG_ 406899944 current_shunt "Shunt current";

CM_ BO_ 406834408 "SOC Current Frame 183FCCE8";
CM_ SG_ 406834408 state_current_num "State - current number";
CM_ SG_ 406834408 soc "SOC";
CM_ SG_ 406834408 inputs "Inputs";
CM_ SG_ 406834408 outputs "Outputs";
CM_ SG_ 406834408 voltage_stack "Stack voltage - HV1";
CM_ SG_ 406834408 current_system "System Current";

CM_ BO_ 405851368 "Our Frame 1";
CM_ BO_ 405916904 "Our Frame 2";
CM_ BO_ 406375656 "Our Frame 3";
CM_ BO_ 406703336 "Error Frames";

BA_DEF_ SG_  "SPN" INT 0 524287;
BA_DEF_ SG_  "SigType" STRING ;

BA_DEF_ BO_  "VFrameFormat" ENUM  "StandardCAN","ExtendedCAN","reserved","J1939PG";
BA_DEF_ BO_  "FilterLabel" INT 0 1;

BA_DEF_DEF_  "SPN" 0;
BA_DEF_DEF_  "VFrameFormat" "J1939PG";
BA_DEF_DEF_  "FilterLabel" 1;
BA_DEF_DEF_  "SigType" "";

BA_ "SPN" SG_ 406768872 temperature_diode 190;
BA_ "SPN" SG_ 406768872 temperature_contactor 192;
BA_ "SPN" SG_ 406768872 temperature_max_mono 194;
BA_ "SPN" SG_ 406768872 temperature_min_mono 196;
BA_ "SPN" SG_ 406768872 voltage_max_mono 198;
BA_ "SPN" SG_ 406768872 voltage_min_mono 199;

BA_ "SPN" SG_ 406899944 power_instant 202;
BA_ "SPN" SG_ 406899944 power_cumulative 204;
BA_ "SPN" SG_ 406899944 current_hall 206;
BA_ "SPN" SG_ 406899944 current_shunt 208;

BA_ "SPN" SG_ 406834408 state_current_num 210;
BA_ "SigType" SG_ 406834408 state_current_num "DISCRETE";
BA_ "SPN" SG_ 406834408 soc 212;
BA_ "SPN" SG_ 406834408 inputs 214;
BA_ "SPN" SG_ 406834408 outputs 216;
BA_ "SPN" SG_ 406834408 voltage_stack 218;
BA_ "SPN" SG_ 406834408 current_system 220;
