VERSION "0.10"

NS_ :

BS_:
BU_: MASTER SLAVE/181

BO_ 404813184 SLAVE1_OVERVIEW1: 8 MASTER
    SG_ hv1_voltage : 0|16@0+ (0.1,0) [0|6553.5] "Volts" SLAVE
    SG_ hv2_voltage : 16|16@0+ (0.1,0) [0|6553.5] "Volts" SLAVE
    SG_ current_sensor_voltage : 32|16@0+ (0.1,-1600) [-1600|4953.5] "Amps" SLAVE
    SG_ module_soc : 48|8@1+ (1,0) [0|100] "Percent" SLAVE
    SG_ output_1 : 56|1@1+ (1,0) [0|0] "" SLAVE
    SG_ output_2 : 57|1@1+ (1,0) [0|0] "" SLAVE
    SG_ output_3 : 58|1@1+ (1,0) [0|0] "" SLAVE
    SG_ output_4 : 59|1@1+ (1,0) [0|0] "" SLAVE
    SG_ output_5 : 60|1@1+ (1,0) [0|0] "" SLAVE
    SG_ output_6 : 61|1@1+ (1,0) [0|0] "" SLAVE
    SG_ output_7 : 62|1@1+ (1,0) [0|0] "" SLAVE
    SG_ output_8 : 63|1@1+ (1,0) [0|0] "" SLAVE

BO_ 406834408 SOC_CURRENT: 8 MASTER
    SG_ state_current_num : 0|8@1+ (1,0) [0|7] "STATE" SLAVE
    SG_ soc : 8|8@1+ (1,0) [0|100] "Percent" SLAVE
    SG_ input_1 : 16|1@1+ (1,0) [0|0] "" SLAVE
    SG_ input_2 : 17|1@1+ (1,0) [0|0] "" SLAVE
    SG_ input_3 : 18|1@1+ (1,0) [0|0] "" SLAVE
    SG_ input_4 : 19|1@1+ (1,0) [0|0] "" SLAVE
    SG_ input_5 : 20|1@1+ (1,0) [0|0] "" SLAVE
    SG_ input_6 : 21|1@1+ (1,0) [0|0] "" SLAVE
    SG_ input_7 : 22|1@1+ (1,0) [0|0] "" SLAVE
    SG_ input_8 : 23|1@1+ (1,0) [0|0] "" SLAVE
    SG_ output_1 : 24|1@1+ (1,0) [0|0] "" SLAVE
    SG_ output_2 : 25|1@1+ (1,0) [0|0] "" SLAVE
    SG_ output_3 : 26|1@1+ (1,0) [0|0] "" SLAVE
    SG_ output_4 : 27|1@1+ (1,0) [0|0] "" SLAVE
    SG_ output_5 : 28|1@1+ (1,0) [0|0] "" SLAVE
    SG_ output_6 : 29|1@1+ (1,0) [0|0] "" SLAVE
    SG_ output_7 : 30|1@1+ (1,0) [0|0] "" SLAVE
    SG_ output_8 : 31|1@1+ (1,0) [0|0] "" SLAVE
    SG_ voltage_stack : 16|16@0+ (0.1,0) [0|6553.5] "Volts" SLAVE
    SG_ current_system : 0|16@0+ (0.1,-1600) [-1600|4953.5] "Amps" SLAVE

BO_ 406637800 DEBUG_FRAME: 8 MASTER
    SG_ debug_frame_id M : 0|8@1+ (1,0) [0|0] "" SLAVE
    SG_ voltage_hv1 m4 : 8|16@1+ (0.1,0) [0|6553.5] "Volts" SLAVE
    SG_ voltage_hv2 m4 : 24|16@1+ (0.1,0) [0|6553.5] "Volts" SLAVE
    SG_ voltage_supply m4 : 40|16@1+ (0.1,0) [0|6553.5] "Volts" SLAVE

BO_ 406113512 RAW_FRAME: 8 MASTER
    SG_ raw_frameid M : 0|8@1+ (1,0) [0|7] "" SLAVE
    SG_ raw_state_present_num m1 : 8|8@1+ (1,0) [0|7] "STATE" SLAVE
    SG_ raw_state_previous_num m1 : 16|8@1+ (1,0) [0|7] "STATE" SLAVE
    SG_ raw_state_historic_num m1 : 24|8@1+ (1,0) [0|7] "STATE" SLAVE
    SG_ raw_temperature_system m1 : 40|8@1+ (1,-40) [-40|215] "Celcius" SLAVE
    SG_ raw_state_error_message m1 : 32|8@1+ (1,0) [0|25] "" SLAVE
    SG_ raw_temperature_diode m1 : 48|8@1+ (1,-40) [-40|215] "Celcius" SLAVE
    SG_ raw_temperature_contactor m1 : 56|8@1+ (1,-40) [-40|215] "Celcius" SLAVE
    SG_ raw_current_system m2 : 8|16@0+ (0.1,-1600) [-1600|4953.5] "Amps" SLAVE
    SG_ raw_current_hall m2 : 24|16@0+ (0.1,-1600) [-1600|4953.5] "Amps" SLAVE
    SG_ raw_current_shunt m2 : 40|16@0+ (0.1,-1600) [-1600|4953.5] "Amps" SLAVE
    SG_ raw_soc m2 : 56|8@1+ (1,0) [0|100] "Percent" SLAVE
    SG_ raw_voltage_supply m3 : 8|16@0+ (0.1,0) [0|6553.5] "Volts" SLAVE
    SG_ raw_voltage_inverter m3 : 24|16@0+ (0.1,0) [0|6553.5] "Volts" SLAVE
    SG_ raw_voltage_stack m3 : 40|16@0+ (0.1,0) [0|6553.5] "Volts" SLAVE
    SG_ raw_soh m3 : 56|8@1+ (1,0) [0|100] "Percent" SLAVE

BO_ 405851368 MONOBLOCK_VOLTAGE_FRAMES: 8 MASTER
BO_ 405916904 MONOBLOCK_TEMPERATURE_FRAMES: 8 MASTER
BO_ 406375656 STATE_MACHINE_DEBUG_FRAMES: 8 MASTER
0

BO_ 406703336 ERROR_FRAME: 8 MASTER
    SG_ raw_errorid M : 0|8@1+ (1,0) [0|0] "" SLAVE
    SG_ critical_feed_charge_overcurrent m1 : 16|1@1+ (1,0) [0|0] "" SLAVE
    SG_ critical_slow_charge_overcurrent m1 : 17|1@1+ (1,0) [0|0] "" SLAVE
    SG_ critical_pack_overvolt m1 : 18|1@1+ (1,0) [0|0] "" SLAVE
    SG_ critical_pack_undervolt m1 : 19|1@1+ (1,0) [0|0] "" SLAVE
    SG_ critical_pack_overtemp m1 : 20|1@1+ (1,0) [0|0] "" SLAVE
    SG_ critical_pack_undertemp m1 : 21|1@1+ (1,0) [0|0] "" SLAVE
    SG_ critical_power_supply_overvolt m1 : 22|1@1+ (1,0) [0|0] "" SLAVE
    SG_ critical_power_supply_undervolt m1 : 23|1@1+ (1,0) [0|0] "" SLAVE
    SG_ critical_cell_charge_overtemp m1 : 24|1@1+ (1,0) [0|0] "" SLAVE
    SG_ critical_cell_voltage_differential m1 : 25|1@1+ (1,0) [0|0] "" SLAVE
    SG_ critical_single_cell_undervolt m1 : 26|1@1+ (1,0) [0|0] "" SLAVE
    SG_ critical_single_cell_overvolt m1 : 27|1@1+ (1,0) [0|0] "" SLAVE
    SG_ critical_soc_low m1 : 28|1@1+ (1,0) [0|0] "" SLAVE
    SG_ critical_soc_high m1 : 29|1@1+ (1,0) [0|0] "" SLAVE
    SG_ critical_insulation_resistance m1 : 30|1@1+ (1,0) [0|0] "" SLAVE
    SG_ critical_discharge_overcurrent m1 : 31|1@1+ (1,0) [0|0] "" SLAVE
    SG_ critical_cell_soc_differential m1 : 35|1@1+ (1,0) [0|0] "" SLAVE
    SG_ critical_cell_temperature_differential m1 : 36|1@1+ (1,0) [0|0] "" SLAVE
    SG_ critical_discharge_overtemp m1 : 37|1@1+ (1,0) [0|0] "" SLAVE
    SG_ critical_charge_overtemp m1 : 38|1@1+ (1,0) [0|0] "" SLAVE
    SG_ critical_charge_undertemp m1 : 39|1@1+ (1,0) [0|0] "" SLAVE

0
CM_ BO_ 406768872 "Temp Voltage Frame 183ECCE8";
CM_ BO_ 406899944 "Power Current Frame 1840CCE8";
CM_ BO_ 406834408 "SOC Current Frame 183FCCE8";

CM_ BO_ 405851368 "Our Frame 1";
CM_ BO_ 405916904 "Our Frame 2";
CM_ BO_ 406375656 "Our Frame 3";
CM_ BO_ 406703336 "Error Frames";

BA_DEF_ BO_  "VFrameFormat" ENUM  "StandardCAN","ExtendedCAN","reserved","J1939PG";
BA_DEF_ BO_  "FilterLabel" INT 0 1;

BA_DEF_DEF_  "VFrameFormat" "J1939PG";
BA_DEF_DEF_  "FilterLabel" 1;
